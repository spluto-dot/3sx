SECTIONS
{
    __romPos = 0;
    _gp = 0x0;
    elf_header_ROM_START = __romPos;
    elf_header_VRAM = ADDR(.elf_header);
    .elf_header : AT(elf_header_ROM_START)
    {
        FILL(0x00000000);
        elf_header_DATA_START = .;
        elf_header_s = .;
        build/asm/data/elf_header.s.o(.data);
        elf_header_DATA_END = .;
        elf_header_DATA_SIZE = ABSOLUTE(elf_header_DATA_END - elf_header_DATA_START);
    }
    __romPos += SIZEOF(.elf_header);
    elf_header_ROM_END = __romPos;
    elf_header_VRAM_END = .;

    main_ROM_START = __romPos;
    main_VRAM = ADDR(.main);
    .main 0x100000 : AT(main_ROM_START)
    {
        FILL(0x00000000);
        main_TEXT_START = .;
        . += 0x8;
        build/asm/main.s.o(.text);
        build/asm/000868.s.o(.text);
        build/asm/000D68.s.o(.text);
        build/asm/000DC8.s.o(.text);
        build/asm/0010F8.s.o(.text);
        build/asm/0011D8.s.o(.text);
        build/asm/001318.s.o(.text);
        build/asm/001408.s.o(.text);
        build/asm/0014B8.s.o(.text);
        build/asm/001538.s.o(.text);
        build/asm/001638.s.o(.text);
        build/asm/0016A8.s.o(.text);
        build/asm/001728.s.o(.text);
        build/asm/001A98.s.o(.text);
        build/asm/001BE8.s.o(.text);
        build/asm/001C38.s.o(.text);
        build/asm/002098.s.o(.text);
        build/asm/002268.s.o(.text);
        build/asm/002548.s.o(.text);
        build/asm/002848.s.o(.text);
        build/asm/002868.s.o(.text);
        build/asm/0028F8.s.o(.text);
        build/asm/0035E8.s.o(.text);
        build/asm/003668.s.o(.text);
        build/asm/003918.s.o(.text);
        build/asm/003998.s.o(.text);
        build/asm/003A58.s.o(.text);
        build/asm/003AD8.s.o(.text);
        build/asm/003F68.s.o(.text);
        build/asm/003FE8.s.o(.text);
        build/asm/0041B8.s.o(.text);
        build/asm/004238.s.o(.text);
        build/asm/0042C8.s.o(.text);
        build/asm/004358.s.o(.text);
        build/asm/0043A8.s.o(.text);
        build/asm/0045E8.s.o(.text);
        build/asm/004A18.s.o(.text);
        build/asm/0052C8.s.o(.text);
        build/asm/0052D8.s.o(.text);
        build/asm/0055D8.s.o(.text);
        build/asm/005808.s.o(.text);
        build/asm/005848.s.o(.text);
        build/asm/005888.s.o(.text);
        build/asm/005C48.s.o(.text);
        build/asm/006108.s.o(.text);
        build/asm/006218.s.o(.text);
        build/asm/0063E8.s.o(.text);
        build/asm/0066B8.s.o(.text);
        build/asm/006C68.s.o(.text);
        build/asm/007158.s.o(.text);
        build/asm/0073A8.s.o(.text);
        build/asm/007438.s.o(.text);
        build/asm/0076F8.s.o(.text);
        build/asm/007878.s.o(.text);
        build/asm/008348.s.o(.text);
        build/asm/008528.s.o(.text);
        build/asm/0093D8.s.o(.text);
        build/asm/0095E8.s.o(.text);
        build/asm/00A438.s.o(.text);
        build/asm/00A6F8.s.o(.text);
        build/asm/00A778.s.o(.text);
        build/asm/00A908.s.o(.text);
        build/asm/00B178.s.o(.text);
        build/asm/00B1B8.s.o(.text);
        build/asm/00B3F8.s.o(.text);
        build/asm/00B4D8.s.o(.text);
        build/asm/00C0B8.s.o(.text);
        build/asm/00C128.s.o(.text);
        build/asm/00C1F8.s.o(.text);
        build/asm/00C2F8.s.o(.text);
        build/asm/00CAB8.s.o(.text);
        build/asm/00CEC8.s.o(.text);
        build/asm/00D418.s.o(.text);
        build/asm/00D4C8.s.o(.text);
        build/asm/00D578.s.o(.text);
        build/asm/00D5C8.s.o(.text);
        build/asm/00D848.s.o(.text);
        build/asm/00D8B8.s.o(.text);
        build/asm/00D908.s.o(.text);
        build/asm/00DC28.s.o(.text);
        build/asm/00DC78.s.o(.text);
        build/asm/00DCD8.s.o(.text);
        build/asm/00DE08.s.o(.text);
        build/asm/00E808.s.o(.text);
        build/asm/00EB98.s.o(.text);
        build/asm/00EBB8.s.o(.text);
        build/asm/00FF08.s.o(.text);
        build/asm/00FF58.s.o(.text);
        build/asm/00FF98.s.o(.text);
        build/asm/010058.s.o(.text);
        build/asm/0109E8.s.o(.text);
        build/asm/010BA8.s.o(.text);
        build/asm/010C38.s.o(.text);
        build/asm/010E48.s.o(.text);
        build/asm/010F68.s.o(.text);
        build/asm/011028.s.o(.text);
        build/asm/0111F8.s.o(.text);
        build/asm/011358.s.o(.text);
        build/asm/011428.s.o(.text);
        build/asm/011538.s.o(.text);
        build/asm/0129D8.s.o(.text);
        build/asm/013028.s.o(.text);
        build/asm/013108.s.o(.text);
        build/asm/015A38.s.o(.text);
        build/asm/015C38.s.o(.text);
        build/asm/015C88.s.o(.text);
        build/asm/015E68.s.o(.text);
        build/asm/252E78.s.o(.text);
        build/asm/252EC8.s.o(.text);
        build/asm/252F18.s.o(.text);
        build/asm/253048.s.o(.text);
        build/asm/2534D8.s.o(.text);
        build/asm/253648.s.o(.text);
        build/asm/253818.s.o(.text);
        build/asm/253C68.s.o(.text);
        build/asm/254CA8.s.o(.text);
        build/asm/254CC8.s.o(.text);
        build/asm/254CE8.s.o(.text);
        build/asm/254F68.s.o(.text);
        build/asm/2555C8.s.o(.text);
        build/asm/2555D8.s.o(.text);
        build/asm/2555E8.s.o(.text);
        build/asm/2556E8.s.o(.text);
        build/asm/255808.s.o(.text);
        build/asm/255AE8.s.o(.text);
        build/asm/255B98.s.o(.text);
        build/asm/2564C8.s.o(.text);
        build/asm/256998.s.o(.text);
        build/asm/256D38.s.o(.text);
        build/asm/256DB8.s.o(.text);
        build/asm/257058.s.o(.text);
        build/asm/257388.s.o(.text);
        build/asm/257898.s.o(.text);
        build/asm/2578A8.s.o(.text);
        build/asm/258178.s.o(.text);
        build/asm/2589E8.s.o(.text);
        build/asm/258C08.s.o(.text);
        build/asm/258E68.s.o(.text);
        build/asm/258E98.s.o(.text);
        build/asm/259068.s.o(.text);
        build/asm/259AF8.s.o(.text);
        build/asm/259EC8.s.o(.text);
        build/asm/25A058.s.o(.text);
        build/asm/25A098.s.o(.text);
        build/asm/25A188.s.o(.text);
        build/asm/25A5A8.s.o(.text);
        build/asm/25A828.s.o(.text);
        build/asm/25A898.s.o(.text);
        build/asm/25A968.s.o(.text);
        build/asm/25ABF8.s.o(.text);
        build/asm/25AC18.s.o(.text);
        build/asm/25AF78.s.o(.text);
        build/asm/25B6C8.s.o(.text);
        build/asm/25B7E8.s.o(.text);
        build/asm/25BC28.s.o(.text);
        build/asm/25BC58.s.o(.text);
        build/asm/25BC88.s.o(.text);
        build/asm/25BD08.s.o(.text);
        build/asm/25BF68.s.o(.text);
        build/asm/25C038.s.o(.text);
        build/asm/25C108.s.o(.text);
        build/asm/25C1D8.s.o(.text);
        build/asm/25C2A8.s.o(.text);
        build/asm/25C378.s.o(.text);
        build/asm/25C448.s.o(.text);
        build/asm/25C478.s.o(.text);
        build/asm/25C488.s.o(.text);
        build/asm/25C5C8.s.o(.text);
        build/asm/25C6E8.s.o(.text);
        build/asm/25C748.s.o(.text);
        build/asm/25C808.s.o(.text);
        build/asm/25C888.s.o(.text);
        build/asm/25CB68.s.o(.text);
        build/asm/25CC78.s.o(.text);
        build/asm/25CCC8.s.o(.text);
        build/asm/25CCF8.s.o(.text);
        build/asm/25CD28.s.o(.text);
        build/asm/25CDC8.s.o(.text);
        build/asm/25CDF8.s.o(.text);
        build/asm/25CE28.s.o(.text);
        build/asm/25CEA8.s.o(.text);
        build/asm/25CED8.s.o(.text);
        build/asm/25CF08.s.o(.text);
        build/asm/25CF38.s.o(.text);
        build/asm/25CF68.s.o(.text);
        build/asm/25CF98.s.o(.text);
        build/asm/25CFC8.s.o(.text);
        build/asm/25D018.s.o(.text);
        build/asm/25D068.s.o(.text);
        build/asm/25D0C8.s.o(.text);
        build/asm/25D368.s.o(.text);
        build/asm/25D398.s.o(.text);
        build/asm/25D3C8.s.o(.text);
        build/asm/25DAC8.s.o(.text);
        build/asm/25DEC8.s.o(.text);
        build/asm/25DED8.s.o(.text);
        build/asm/25DEE8.s.o(.text);
        build/asm/25E158.s.o(.text);
        build/asm/25E218.s.o(.text);
        build/asm/25E238.s.o(.text);
        build/asm/25E268.s.o(.text);
        build/asm/25E568.s.o(.text);
        build/asm/25E638.s.o(.text);
        build/asm/25E808.s.o(.text);
        build/asm/25EF58.s.o(.text);
        build/asm/25EF68.s.o(.text);
        build/asm/25F328.s.o(.text);
        build/asm/25F3A8.s.o(.text);
        build/asm/25F3D8.s.o(.text);
        build/asm/25F548.s.o(.text);
        build/asm/25F9C8.s.o(.text);
        build/asm/25FCE8.s.o(.text);
        build/asm/25FDD8.s.o(.text);
        build/asm/25FF28.s.o(.text);
        build/asm/2602D8.s.o(.text);
        build/asm/2605E8.s.o(.text);
        build/asm/260688.s.o(.text);
        build/asm/2606D8.s.o(.text);
        build/asm/260728.s.o(.text);
        build/asm/260778.s.o(.text);
        build/asm/2607C8.s.o(.text);
        build/asm/260918.s.o(.text);
        build/asm/260A48.s.o(.text);
        build/asm/260B08.s.o(.text);
        build/asm/260CE8.s.o(.text);
        build/asm/260D58.s.o(.text);
        build/asm/261158.s.o(.text);
        build/asm/2611E8.s.o(.text);
        build/asm/2615E8.s.o(.text);
        build/asm/261648.s.o(.text);
        build/asm/2617E8.s.o(.text);
        build/asm/261D28.s.o(.text);
        build/asm/2621D8.s.o(.text);
        build/asm/262728.s.o(.text);
        build/asm/2627E8.s.o(.text);
        build/asm/262AE8.s.o(.text);
        build/asm/262D38.s.o(.text);
        build/asm/262F18.s.o(.text);
        build/asm/262F88.s.o(.text);
        build/asm/262FD8.s.o(.text);
        build/asm/2630A8.s.o(.text);
        build/asm/2630F8.s.o(.text);
        build/asm/263188.s.o(.text);
        build/asm/263248.s.o(.text);
        build/asm/263398.s.o(.text);
        build/asm/263428.s.o(.text);
        build/asm/263518.s.o(.text);
        build/asm/263788.s.o(.text);
        build/asm/263958.s.o(.text);
        build/asm/263CE8.s.o(.text);
        build/asm/263CF8.s.o(.text);
        build/asm/263EA8.s.o(.text);
        build/asm/264178.s.o(.text);
        build/asm/264578.s.o(.text);
        build/asm/264638.s.o(.text);
        build/asm/2646F8.s.o(.text);
        build/asm/264988.s.o(.text);
        build/asm/264CA8.s.o(.text);
        build/asm/264D38.s.o(.text);
        build/asm/265418.s.o(.text);
        build/asm/265538.s.o(.text);
        build/asm/265868.s.o(.text);
        build/asm/265BF8.s.o(.text);
        build/asm/265F98.s.o(.text);
        build/asm/265FA8.s.o(.text);
        build/asm/266098.s.o(.text);
        build/asm/2660A8.s.o(.text);
        build/asm/2660B8.s.o(.text);
        build/asm/266508.s.o(.text);
        build/asm/266518.s.o(.text);
        build/asm/266588.s.o(.text);
        build/asm/2667A8.s.o(.text);
        build/asm/266878.s.o(.text);
        build/asm/266BF8.s.o(.text);
        build/asm/267188.s.o(.text);
        build/asm/267C58.s.o(.text);
        build/asm/267C78.s.o(.text);
        build/asm/2683A8.s.o(.text);
        build/asm/268518.s.o(.text);
        build/asm/2685A8.s.o(.text);
        build/asm/2687D8.s.o(.text);
        build/asm/268B38.s.o(.text);
        build/asm/268C28.s.o(.text);
        build/asm/268CD8.s.o(.text);
        build/asm/268E88.s.o(.text);
        build/asm/269018.s.o(.text);
        build/asm/269128.s.o(.text);
        build/asm/269158.s.o(.text);
        build/asm/269188.s.o(.text);
        build/asm/2692D8.s.o(.text);
        build/asm/269558.s.o(.text);
        build/asm/269A68.s.o(.text);
        build/asm/269E78.s.o(.text);
        build/asm/269E98.s.o(.text);
        build/asm/269EC8.s.o(.text);
        build/asm/26A2C8.s.o(.text);
        build/asm/26A468.s.o(.text);
        build/asm/26A7B8.s.o(.text);
        build/asm/26AD38.s.o(.text);
        build/asm/26AD48.s.o(.text);
        build/asm/26AD58.s.o(.text);
        build/asm/26AD68.s.o(.text);
        build/asm/26AD78.s.o(.text);
        build/asm/26B228.s.o(.text);
        build/asm/26B268.s.o(.text);
        build/asm/26B4E8.s.o(.text);
        build/asm/26B5E8.s.o(.text);
        build/asm/26B6F8.s.o(.text);
        build/asm/26BCC8.s.o(.text);
        build/asm/26BD38.s.o(.text);
        build/asm/26BD98.s.o(.text);
        build/asm/26BDD8.s.o(.text);
        build/asm/26BE08.s.o(.text);
        build/asm/26BF98.s.o(.text);
        build/asm/26BFB8.s.o(.text);
        build/asm/26BFE8.s.o(.text);
        build/asm/26C258.s.o(.text);
        build/asm/26C3F8.s.o(.text);
        build/asm/26C448.s.o(.text);
        build/asm/26C538.s.o(.text);
        build/asm/26C6F8.s.o(.text);
        build/asm/26C978.s.o(.text);
        build/asm/26CDC8.s.o(.text);
        build/asm/26D3E8.s.o(.text);
        build/asm/26D458.s.o(.text);
        build/asm/26D4D8.s.o(.text);
        build/asm/26D558.s.o(.text);
        build/asm/26D608.s.o(.text);
        build/asm/26DB38.s.o(.text);
        build/asm/26DB58.s.o(.text);
        build/asm/26DFA8.s.o(.text);
        build/asm/26E008.s.o(.text);
        build/asm/26E0F8.s.o(.text);
        build/asm/26E128.s.o(.text);
        build/asm/26E138.s.o(.text);
        build/asm/26E148.s.o(.text);
        build/asm/26E1B8.s.o(.text);
        build/asm/26E3A8.s.o(.text);
        build/asm/26E6F8.s.o(.text);
        build/asm/26E728.s.o(.text);
        build/asm/26E7D8.s.o(.text);
        build/asm/26E9B8.s.o(.text);
        build/asm/26EB28.s.o(.text);
        build/asm/26F0D8.s.o(.text);
        build/asm/26F128.s.o(.text);
        build/asm/26F1B8.s.o(.text);
        build/asm/26F368.s.o(.text);
        build/asm/26F608.s.o(.text);
        build/asm/26F698.s.o(.text);
        build/asm/26F6D8.s.o(.text);
        build/asm/26F808.s.o(.text);
        build/asm/26F8B8.s.o(.text);
        build/asm/26F918.s.o(.text);
        build/asm/26FA78.s.o(.text);
        build/asm/26FE48.s.o(.text);
        build/asm/26FEE8.s.o(.text);
        build/asm/270898.s.o(.text);
        build/asm/270B88.s.o(.text);
        build/asm/270C48.s.o(.text);
        build/asm/270D38.s.o(.text);
        build/asm/270E18.s.o(.text);
        build/asm/271128.s.o(.text);
        build/asm/271F08.s.o(.text);
        build/asm/272248.s.o(.text);
        build/asm/273688.s.o(.text);
        build/asm/2736E8.s.o(.text);
        build/asm/273878.s.o(.text);
        build/asm/273898.s.o(.text);
        build/asm/273928.s.o(.text);
        build/asm/274268.s.o(.text);
        build/asm/2742F8.s.o(.text);
        build/asm/274308.s.o(.text);
        build/asm/274508.s.o(.text);
        build/asm/2750D8.s.o(.text);
        build/asm/2754C8.s.o(.text);
        build/asm/2754F8.s.o(.text);
        build/asm/275AB8.s.o(.text);
        build/asm/275BB8.s.o(.text);
        build/asm/2762F8.s.o(.text);
        build/asm/2763C8.s.o(.text);
        build/asm/276498.s.o(.text);
        build/asm/276828.s.o(.text);
        build/asm/276848.s.o(.text);
        build/asm/276D28.s.o(.text);
        build/asm/277128.s.o(.text);
        build/asm/277668.s.o(.text);
        build/asm/278F78.s.o(.text);
        build/asm/279028.s.o(.text);
        build/asm/286858.s.o(.text);
        build/asm/286A98.s.o(.text);
        build/asm/287608.s.o(.text);
        build/asm/2876F8.s.o(.text);
        build/asm/287928.s.o(.text);
        build/asm/287E28.s.o(.text);
        . = ALIGN(., 16);
        main_TEXT_END = .;
        main_TEXT_SIZE = ABSOLUTE(main_TEXT_END - main_TEXT_START);
        main_DATA_START = .;
        main_s = .;
        build/asm/main.s.o(.data);
        _000868_s = .;
        build/asm/000868.s.o(.data);
        _000D68_s = .;
        build/asm/000D68.s.o(.data);
        _000DC8_s = .;
        build/asm/000DC8.s.o(.data);
        _0010F8_s = .;
        build/asm/0010F8.s.o(.data);
        _0011D8_s = .;
        build/asm/0011D8.s.o(.data);
        _001318_s = .;
        build/asm/001318.s.o(.data);
        _001408_s = .;
        build/asm/001408.s.o(.data);
        _0014B8_s = .;
        build/asm/0014B8.s.o(.data);
        _001538_s = .;
        build/asm/001538.s.o(.data);
        _001638_s = .;
        build/asm/001638.s.o(.data);
        _0016A8_s = .;
        build/asm/0016A8.s.o(.data);
        _001728_s = .;
        build/asm/001728.s.o(.data);
        _001A98_s = .;
        build/asm/001A98.s.o(.data);
        _001BE8_s = .;
        build/asm/001BE8.s.o(.data);
        _001C38_s = .;
        build/asm/001C38.s.o(.data);
        _002098_s = .;
        build/asm/002098.s.o(.data);
        _002268_s = .;
        build/asm/002268.s.o(.data);
        _002548_s = .;
        build/asm/002548.s.o(.data);
        _002848_s = .;
        build/asm/002848.s.o(.data);
        _002868_s = .;
        build/asm/002868.s.o(.data);
        _0028F8_s = .;
        build/asm/0028F8.s.o(.data);
        _0035E8_s = .;
        build/asm/0035E8.s.o(.data);
        _003668_s = .;
        build/asm/003668.s.o(.data);
        _003918_s = .;
        build/asm/003918.s.o(.data);
        _003998_s = .;
        build/asm/003998.s.o(.data);
        _003A58_s = .;
        build/asm/003A58.s.o(.data);
        _003AD8_s = .;
        build/asm/003AD8.s.o(.data);
        _003F68_s = .;
        build/asm/003F68.s.o(.data);
        _003FE8_s = .;
        build/asm/003FE8.s.o(.data);
        _0041B8_s = .;
        build/asm/0041B8.s.o(.data);
        _004238_s = .;
        build/asm/004238.s.o(.data);
        _0042C8_s = .;
        build/asm/0042C8.s.o(.data);
        _004358_s = .;
        build/asm/004358.s.o(.data);
        _0043A8_s = .;
        build/asm/0043A8.s.o(.data);
        _0045E8_s = .;
        build/asm/0045E8.s.o(.data);
        _004A18_s = .;
        build/asm/004A18.s.o(.data);
        _0052C8_s = .;
        build/asm/0052C8.s.o(.data);
        _0052D8_s = .;
        build/asm/0052D8.s.o(.data);
        _0055D8_s = .;
        build/asm/0055D8.s.o(.data);
        _005808_s = .;
        build/asm/005808.s.o(.data);
        _005848_s = .;
        build/asm/005848.s.o(.data);
        _005888_s = .;
        build/asm/005888.s.o(.data);
        _005C48_s = .;
        build/asm/005C48.s.o(.data);
        _006108_s = .;
        build/asm/006108.s.o(.data);
        _006218_s = .;
        build/asm/006218.s.o(.data);
        _0063E8_s = .;
        build/asm/0063E8.s.o(.data);
        _0066B8_s = .;
        build/asm/0066B8.s.o(.data);
        _006C68_s = .;
        build/asm/006C68.s.o(.data);
        _007158_s = .;
        build/asm/007158.s.o(.data);
        _0073A8_s = .;
        build/asm/0073A8.s.o(.data);
        _007438_s = .;
        build/asm/007438.s.o(.data);
        _0076F8_s = .;
        build/asm/0076F8.s.o(.data);
        _007878_s = .;
        build/asm/007878.s.o(.data);
        _008348_s = .;
        build/asm/008348.s.o(.data);
        _008528_s = .;
        build/asm/008528.s.o(.data);
        _0093D8_s = .;
        build/asm/0093D8.s.o(.data);
        _0095E8_s = .;
        build/asm/0095E8.s.o(.data);
        _00A438_s = .;
        build/asm/00A438.s.o(.data);
        _00A6F8_s = .;
        build/asm/00A6F8.s.o(.data);
        _00A778_s = .;
        build/asm/00A778.s.o(.data);
        _00A908_s = .;
        build/asm/00A908.s.o(.data);
        _00B178_s = .;
        build/asm/00B178.s.o(.data);
        _00B1B8_s = .;
        build/asm/00B1B8.s.o(.data);
        _00B3F8_s = .;
        build/asm/00B3F8.s.o(.data);
        _00B4D8_s = .;
        build/asm/00B4D8.s.o(.data);
        _00C0B8_s = .;
        build/asm/00C0B8.s.o(.data);
        _00C128_s = .;
        build/asm/00C128.s.o(.data);
        _00C1F8_s = .;
        build/asm/00C1F8.s.o(.data);
        _00C2F8_s = .;
        build/asm/00C2F8.s.o(.data);
        _00CAB8_s = .;
        build/asm/00CAB8.s.o(.data);
        _00CEC8_s = .;
        build/asm/00CEC8.s.o(.data);
        _00D418_s = .;
        build/asm/00D418.s.o(.data);
        _00D4C8_s = .;
        build/asm/00D4C8.s.o(.data);
        _00D578_s = .;
        build/asm/00D578.s.o(.data);
        _00D5C8_s = .;
        build/asm/00D5C8.s.o(.data);
        _00D848_s = .;
        build/asm/00D848.s.o(.data);
        _00D8B8_s = .;
        build/asm/00D8B8.s.o(.data);
        _00D908_s = .;
        build/asm/00D908.s.o(.data);
        _00DC28_s = .;
        build/asm/00DC28.s.o(.data);
        _00DC78_s = .;
        build/asm/00DC78.s.o(.data);
        _00DCD8_s = .;
        build/asm/00DCD8.s.o(.data);
        _00DE08_s = .;
        build/asm/00DE08.s.o(.data);
        _00E808_s = .;
        build/asm/00E808.s.o(.data);
        _00EB98_s = .;
        build/asm/00EB98.s.o(.data);
        _00EBB8_s = .;
        build/asm/00EBB8.s.o(.data);
        _00FF08_s = .;
        build/asm/00FF08.s.o(.data);
        _00FF58_s = .;
        build/asm/00FF58.s.o(.data);
        _00FF98_s = .;
        build/asm/00FF98.s.o(.data);
        _010058_s = .;
        build/asm/010058.s.o(.data);
        _0109E8_s = .;
        build/asm/0109E8.s.o(.data);
        _010BA8_s = .;
        build/asm/010BA8.s.o(.data);
        _010C38_s = .;
        build/asm/010C38.s.o(.data);
        _010E48_s = .;
        build/asm/010E48.s.o(.data);
        _010F68_s = .;
        build/asm/010F68.s.o(.data);
        _011028_s = .;
        build/asm/011028.s.o(.data);
        _0111F8_s = .;
        build/asm/0111F8.s.o(.data);
        _011358_s = .;
        build/asm/011358.s.o(.data);
        _011428_s = .;
        build/asm/011428.s.o(.data);
        _011538_s = .;
        build/asm/011538.s.o(.data);
        _0129D8_s = .;
        build/asm/0129D8.s.o(.data);
        _013028_s = .;
        build/asm/013028.s.o(.data);
        _013108_s = .;
        build/asm/013108.s.o(.data);
        _015A38_s = .;
        build/asm/015A38.s.o(.data);
        _015C38_s = .;
        build/asm/015C38.s.o(.data);
        _015C88_s = .;
        build/asm/015C88.s.o(.data);
        _015E68_s = .;
        build/asm/015E68.s.o(.data);
        _252E78_s = .;
        build/asm/252E78.s.o(.data);
        _252EC8_s = .;
        build/asm/252EC8.s.o(.data);
        _252F18_s = .;
        build/asm/252F18.s.o(.data);
        _253048_s = .;
        build/asm/253048.s.o(.data);
        _2534D8_s = .;
        build/asm/2534D8.s.o(.data);
        _253648_s = .;
        build/asm/253648.s.o(.data);
        _253818_s = .;
        build/asm/253818.s.o(.data);
        _253C68_s = .;
        build/asm/253C68.s.o(.data);
        _254CA8_s = .;
        build/asm/254CA8.s.o(.data);
        _254CC8_s = .;
        build/asm/254CC8.s.o(.data);
        _254CE8_s = .;
        build/asm/254CE8.s.o(.data);
        _254F68_s = .;
        build/asm/254F68.s.o(.data);
        _2555C8_s = .;
        build/asm/2555C8.s.o(.data);
        _2555D8_s = .;
        build/asm/2555D8.s.o(.data);
        _2555E8_s = .;
        build/asm/2555E8.s.o(.data);
        _2556E8_s = .;
        build/asm/2556E8.s.o(.data);
        _255808_s = .;
        build/asm/255808.s.o(.data);
        _255AE8_s = .;
        build/asm/255AE8.s.o(.data);
        _255B98_s = .;
        build/asm/255B98.s.o(.data);
        _2564C8_s = .;
        build/asm/2564C8.s.o(.data);
        _256998_s = .;
        build/asm/256998.s.o(.data);
        _256D38_s = .;
        build/asm/256D38.s.o(.data);
        _256DB8_s = .;
        build/asm/256DB8.s.o(.data);
        _257058_s = .;
        build/asm/257058.s.o(.data);
        _257388_s = .;
        build/asm/257388.s.o(.data);
        _257898_s = .;
        build/asm/257898.s.o(.data);
        _2578A8_s = .;
        build/asm/2578A8.s.o(.data);
        _258178_s = .;
        build/asm/258178.s.o(.data);
        _2589E8_s = .;
        build/asm/2589E8.s.o(.data);
        _258C08_s = .;
        build/asm/258C08.s.o(.data);
        _258E68_s = .;
        build/asm/258E68.s.o(.data);
        _258E98_s = .;
        build/asm/258E98.s.o(.data);
        _259068_s = .;
        build/asm/259068.s.o(.data);
        _259AF8_s = .;
        build/asm/259AF8.s.o(.data);
        _259EC8_s = .;
        build/asm/259EC8.s.o(.data);
        _25A058_s = .;
        build/asm/25A058.s.o(.data);
        _25A098_s = .;
        build/asm/25A098.s.o(.data);
        _25A188_s = .;
        build/asm/25A188.s.o(.data);
        _25A5A8_s = .;
        build/asm/25A5A8.s.o(.data);
        _25A828_s = .;
        build/asm/25A828.s.o(.data);
        _25A898_s = .;
        build/asm/25A898.s.o(.data);
        _25A968_s = .;
        build/asm/25A968.s.o(.data);
        _25ABF8_s = .;
        build/asm/25ABF8.s.o(.data);
        _25AC18_s = .;
        build/asm/25AC18.s.o(.data);
        _25AF78_s = .;
        build/asm/25AF78.s.o(.data);
        _25B6C8_s = .;
        build/asm/25B6C8.s.o(.data);
        _25B7E8_s = .;
        build/asm/25B7E8.s.o(.data);
        _25BC28_s = .;
        build/asm/25BC28.s.o(.data);
        _25BC58_s = .;
        build/asm/25BC58.s.o(.data);
        _25BC88_s = .;
        build/asm/25BC88.s.o(.data);
        _25BD08_s = .;
        build/asm/25BD08.s.o(.data);
        _25BF68_s = .;
        build/asm/25BF68.s.o(.data);
        _25C038_s = .;
        build/asm/25C038.s.o(.data);
        _25C108_s = .;
        build/asm/25C108.s.o(.data);
        _25C1D8_s = .;
        build/asm/25C1D8.s.o(.data);
        _25C2A8_s = .;
        build/asm/25C2A8.s.o(.data);
        _25C378_s = .;
        build/asm/25C378.s.o(.data);
        _25C448_s = .;
        build/asm/25C448.s.o(.data);
        _25C478_s = .;
        build/asm/25C478.s.o(.data);
        _25C488_s = .;
        build/asm/25C488.s.o(.data);
        _25C5C8_s = .;
        build/asm/25C5C8.s.o(.data);
        _25C6E8_s = .;
        build/asm/25C6E8.s.o(.data);
        _25C748_s = .;
        build/asm/25C748.s.o(.data);
        _25C808_s = .;
        build/asm/25C808.s.o(.data);
        _25C888_s = .;
        build/asm/25C888.s.o(.data);
        _25CB68_s = .;
        build/asm/25CB68.s.o(.data);
        _25CC78_s = .;
        build/asm/25CC78.s.o(.data);
        _25CCC8_s = .;
        build/asm/25CCC8.s.o(.data);
        _25CCF8_s = .;
        build/asm/25CCF8.s.o(.data);
        _25CD28_s = .;
        build/asm/25CD28.s.o(.data);
        _25CDC8_s = .;
        build/asm/25CDC8.s.o(.data);
        _25CDF8_s = .;
        build/asm/25CDF8.s.o(.data);
        _25CE28_s = .;
        build/asm/25CE28.s.o(.data);
        _25CEA8_s = .;
        build/asm/25CEA8.s.o(.data);
        _25CED8_s = .;
        build/asm/25CED8.s.o(.data);
        _25CF08_s = .;
        build/asm/25CF08.s.o(.data);
        _25CF38_s = .;
        build/asm/25CF38.s.o(.data);
        _25CF68_s = .;
        build/asm/25CF68.s.o(.data);
        _25CF98_s = .;
        build/asm/25CF98.s.o(.data);
        _25CFC8_s = .;
        build/asm/25CFC8.s.o(.data);
        _25D018_s = .;
        build/asm/25D018.s.o(.data);
        _25D068_s = .;
        build/asm/25D068.s.o(.data);
        _25D0C8_s = .;
        build/asm/25D0C8.s.o(.data);
        _25D368_s = .;
        build/asm/25D368.s.o(.data);
        _25D398_s = .;
        build/asm/25D398.s.o(.data);
        _25D3C8_s = .;
        build/asm/25D3C8.s.o(.data);
        _25DAC8_s = .;
        build/asm/25DAC8.s.o(.data);
        _25DEC8_s = .;
        build/asm/25DEC8.s.o(.data);
        _25DED8_s = .;
        build/asm/25DED8.s.o(.data);
        _25DEE8_s = .;
        build/asm/25DEE8.s.o(.data);
        _25E158_s = .;
        build/asm/25E158.s.o(.data);
        _25E218_s = .;
        build/asm/25E218.s.o(.data);
        _25E238_s = .;
        build/asm/25E238.s.o(.data);
        _25E268_s = .;
        build/asm/25E268.s.o(.data);
        _25E568_s = .;
        build/asm/25E568.s.o(.data);
        _25E638_s = .;
        build/asm/25E638.s.o(.data);
        _25E808_s = .;
        build/asm/25E808.s.o(.data);
        _25EF58_s = .;
        build/asm/25EF58.s.o(.data);
        _25EF68_s = .;
        build/asm/25EF68.s.o(.data);
        _25F328_s = .;
        build/asm/25F328.s.o(.data);
        _25F3A8_s = .;
        build/asm/25F3A8.s.o(.data);
        _25F3D8_s = .;
        build/asm/25F3D8.s.o(.data);
        _25F548_s = .;
        build/asm/25F548.s.o(.data);
        _25F9C8_s = .;
        build/asm/25F9C8.s.o(.data);
        _25FCE8_s = .;
        build/asm/25FCE8.s.o(.data);
        _25FDD8_s = .;
        build/asm/25FDD8.s.o(.data);
        _25FF28_s = .;
        build/asm/25FF28.s.o(.data);
        _2602D8_s = .;
        build/asm/2602D8.s.o(.data);
        _2605E8_s = .;
        build/asm/2605E8.s.o(.data);
        _260688_s = .;
        build/asm/260688.s.o(.data);
        _2606D8_s = .;
        build/asm/2606D8.s.o(.data);
        _260728_s = .;
        build/asm/260728.s.o(.data);
        _260778_s = .;
        build/asm/260778.s.o(.data);
        _2607C8_s = .;
        build/asm/2607C8.s.o(.data);
        _260918_s = .;
        build/asm/260918.s.o(.data);
        _260A48_s = .;
        build/asm/260A48.s.o(.data);
        _260B08_s = .;
        build/asm/260B08.s.o(.data);
        _260CE8_s = .;
        build/asm/260CE8.s.o(.data);
        _260D58_s = .;
        build/asm/260D58.s.o(.data);
        _261158_s = .;
        build/asm/261158.s.o(.data);
        _2611E8_s = .;
        build/asm/2611E8.s.o(.data);
        _2615E8_s = .;
        build/asm/2615E8.s.o(.data);
        _261648_s = .;
        build/asm/261648.s.o(.data);
        _2617E8_s = .;
        build/asm/2617E8.s.o(.data);
        _261D28_s = .;
        build/asm/261D28.s.o(.data);
        _2621D8_s = .;
        build/asm/2621D8.s.o(.data);
        _262728_s = .;
        build/asm/262728.s.o(.data);
        _2627E8_s = .;
        build/asm/2627E8.s.o(.data);
        _262AE8_s = .;
        build/asm/262AE8.s.o(.data);
        _262D38_s = .;
        build/asm/262D38.s.o(.data);
        _262F18_s = .;
        build/asm/262F18.s.o(.data);
        _262F88_s = .;
        build/asm/262F88.s.o(.data);
        _262FD8_s = .;
        build/asm/262FD8.s.o(.data);
        _2630A8_s = .;
        build/asm/2630A8.s.o(.data);
        _2630F8_s = .;
        build/asm/2630F8.s.o(.data);
        _263188_s = .;
        build/asm/263188.s.o(.data);
        _263248_s = .;
        build/asm/263248.s.o(.data);
        _263398_s = .;
        build/asm/263398.s.o(.data);
        _263428_s = .;
        build/asm/263428.s.o(.data);
        _263518_s = .;
        build/asm/263518.s.o(.data);
        _263788_s = .;
        build/asm/263788.s.o(.data);
        _263958_s = .;
        build/asm/263958.s.o(.data);
        _263CE8_s = .;
        build/asm/263CE8.s.o(.data);
        _263CF8_s = .;
        build/asm/263CF8.s.o(.data);
        _263EA8_s = .;
        build/asm/263EA8.s.o(.data);
        _264178_s = .;
        build/asm/264178.s.o(.data);
        _264578_s = .;
        build/asm/264578.s.o(.data);
        _264638_s = .;
        build/asm/264638.s.o(.data);
        _2646F8_s = .;
        build/asm/2646F8.s.o(.data);
        _264988_s = .;
        build/asm/264988.s.o(.data);
        _264CA8_s = .;
        build/asm/264CA8.s.o(.data);
        _264D38_s = .;
        build/asm/264D38.s.o(.data);
        _265418_s = .;
        build/asm/265418.s.o(.data);
        _265538_s = .;
        build/asm/265538.s.o(.data);
        _265868_s = .;
        build/asm/265868.s.o(.data);
        _265BF8_s = .;
        build/asm/265BF8.s.o(.data);
        _265F98_s = .;
        build/asm/265F98.s.o(.data);
        _265FA8_s = .;
        build/asm/265FA8.s.o(.data);
        _266098_s = .;
        build/asm/266098.s.o(.data);
        _2660A8_s = .;
        build/asm/2660A8.s.o(.data);
        _2660B8_s = .;
        build/asm/2660B8.s.o(.data);
        _266508_s = .;
        build/asm/266508.s.o(.data);
        _266518_s = .;
        build/asm/266518.s.o(.data);
        _266588_s = .;
        build/asm/266588.s.o(.data);
        _2667A8_s = .;
        build/asm/2667A8.s.o(.data);
        _266878_s = .;
        build/asm/266878.s.o(.data);
        _266BF8_s = .;
        build/asm/266BF8.s.o(.data);
        _267188_s = .;
        build/asm/267188.s.o(.data);
        _267C58_s = .;
        build/asm/267C58.s.o(.data);
        _267C78_s = .;
        build/asm/267C78.s.o(.data);
        _2683A8_s = .;
        build/asm/2683A8.s.o(.data);
        _268518_s = .;
        build/asm/268518.s.o(.data);
        _2685A8_s = .;
        build/asm/2685A8.s.o(.data);
        _2687D8_s = .;
        build/asm/2687D8.s.o(.data);
        _268B38_s = .;
        build/asm/268B38.s.o(.data);
        _268C28_s = .;
        build/asm/268C28.s.o(.data);
        _268CD8_s = .;
        build/asm/268CD8.s.o(.data);
        _268E88_s = .;
        build/asm/268E88.s.o(.data);
        _269018_s = .;
        build/asm/269018.s.o(.data);
        _269128_s = .;
        build/asm/269128.s.o(.data);
        _269158_s = .;
        build/asm/269158.s.o(.data);
        _269188_s = .;
        build/asm/269188.s.o(.data);
        _2692D8_s = .;
        build/asm/2692D8.s.o(.data);
        _269558_s = .;
        build/asm/269558.s.o(.data);
        _269A68_s = .;
        build/asm/269A68.s.o(.data);
        _269E78_s = .;
        build/asm/269E78.s.o(.data);
        _269E98_s = .;
        build/asm/269E98.s.o(.data);
        _269EC8_s = .;
        build/asm/269EC8.s.o(.data);
        _26A2C8_s = .;
        build/asm/26A2C8.s.o(.data);
        _26A468_s = .;
        build/asm/26A468.s.o(.data);
        _26A7B8_s = .;
        build/asm/26A7B8.s.o(.data);
        _26AD38_s = .;
        build/asm/26AD38.s.o(.data);
        _26AD48_s = .;
        build/asm/26AD48.s.o(.data);
        _26AD58_s = .;
        build/asm/26AD58.s.o(.data);
        _26AD68_s = .;
        build/asm/26AD68.s.o(.data);
        _26AD78_s = .;
        build/asm/26AD78.s.o(.data);
        _26B228_s = .;
        build/asm/26B228.s.o(.data);
        _26B268_s = .;
        build/asm/26B268.s.o(.data);
        _26B4E8_s = .;
        build/asm/26B4E8.s.o(.data);
        _26B5E8_s = .;
        build/asm/26B5E8.s.o(.data);
        _26B6F8_s = .;
        build/asm/26B6F8.s.o(.data);
        _26BCC8_s = .;
        build/asm/26BCC8.s.o(.data);
        _26BD38_s = .;
        build/asm/26BD38.s.o(.data);
        _26BD98_s = .;
        build/asm/26BD98.s.o(.data);
        _26BDD8_s = .;
        build/asm/26BDD8.s.o(.data);
        _26BE08_s = .;
        build/asm/26BE08.s.o(.data);
        _26BF98_s = .;
        build/asm/26BF98.s.o(.data);
        _26BFB8_s = .;
        build/asm/26BFB8.s.o(.data);
        _26BFE8_s = .;
        build/asm/26BFE8.s.o(.data);
        _26C258_s = .;
        build/asm/26C258.s.o(.data);
        _26C3F8_s = .;
        build/asm/26C3F8.s.o(.data);
        _26C448_s = .;
        build/asm/26C448.s.o(.data);
        _26C538_s = .;
        build/asm/26C538.s.o(.data);
        _26C6F8_s = .;
        build/asm/26C6F8.s.o(.data);
        _26C978_s = .;
        build/asm/26C978.s.o(.data);
        _26CDC8_s = .;
        build/asm/26CDC8.s.o(.data);
        _26D3E8_s = .;
        build/asm/26D3E8.s.o(.data);
        _26D458_s = .;
        build/asm/26D458.s.o(.data);
        _26D4D8_s = .;
        build/asm/26D4D8.s.o(.data);
        _26D558_s = .;
        build/asm/26D558.s.o(.data);
        _26D608_s = .;
        build/asm/26D608.s.o(.data);
        _26DB38_s = .;
        build/asm/26DB38.s.o(.data);
        _26DB58_s = .;
        build/asm/26DB58.s.o(.data);
        _26DFA8_s = .;
        build/asm/26DFA8.s.o(.data);
        _26E008_s = .;
        build/asm/26E008.s.o(.data);
        _26E0F8_s = .;
        build/asm/26E0F8.s.o(.data);
        _26E128_s = .;
        build/asm/26E128.s.o(.data);
        _26E138_s = .;
        build/asm/26E138.s.o(.data);
        _26E148_s = .;
        build/asm/26E148.s.o(.data);
        _26E1B8_s = .;
        build/asm/26E1B8.s.o(.data);
        _26E3A8_s = .;
        build/asm/26E3A8.s.o(.data);
        _26E6F8_s = .;
        build/asm/26E6F8.s.o(.data);
        _26E728_s = .;
        build/asm/26E728.s.o(.data);
        _26E7D8_s = .;
        build/asm/26E7D8.s.o(.data);
        _26E9B8_s = .;
        build/asm/26E9B8.s.o(.data);
        _26EB28_s = .;
        build/asm/26EB28.s.o(.data);
        _26F0D8_s = .;
        build/asm/26F0D8.s.o(.data);
        _26F128_s = .;
        build/asm/26F128.s.o(.data);
        _26F1B8_s = .;
        build/asm/26F1B8.s.o(.data);
        _26F368_s = .;
        build/asm/26F368.s.o(.data);
        _26F608_s = .;
        build/asm/26F608.s.o(.data);
        _26F698_s = .;
        build/asm/26F698.s.o(.data);
        _26F6D8_s = .;
        build/asm/26F6D8.s.o(.data);
        _26F808_s = .;
        build/asm/26F808.s.o(.data);
        _26F8B8_s = .;
        build/asm/26F8B8.s.o(.data);
        _26F918_s = .;
        build/asm/26F918.s.o(.data);
        _26FA78_s = .;
        build/asm/26FA78.s.o(.data);
        _26FE48_s = .;
        build/asm/26FE48.s.o(.data);
        _26FEE8_s = .;
        build/asm/26FEE8.s.o(.data);
        _270898_s = .;
        build/asm/270898.s.o(.data);
        _270B88_s = .;
        build/asm/270B88.s.o(.data);
        _270C48_s = .;
        build/asm/270C48.s.o(.data);
        _270D38_s = .;
        build/asm/270D38.s.o(.data);
        _270E18_s = .;
        build/asm/270E18.s.o(.data);
        _271128_s = .;
        build/asm/271128.s.o(.data);
        _271F08_s = .;
        build/asm/271F08.s.o(.data);
        _272248_s = .;
        build/asm/272248.s.o(.data);
        _273688_s = .;
        build/asm/273688.s.o(.data);
        _2736E8_s = .;
        build/asm/2736E8.s.o(.data);
        _273878_s = .;
        build/asm/273878.s.o(.data);
        _273898_s = .;
        build/asm/273898.s.o(.data);
        _273928_s = .;
        build/asm/273928.s.o(.data);
        _274268_s = .;
        build/asm/274268.s.o(.data);
        _2742F8_s = .;
        build/asm/2742F8.s.o(.data);
        _274308_s = .;
        build/asm/274308.s.o(.data);
        _274508_s = .;
        build/asm/274508.s.o(.data);
        _2750D8_s = .;
        build/asm/2750D8.s.o(.data);
        _2754C8_s = .;
        build/asm/2754C8.s.o(.data);
        _2754F8_s = .;
        build/asm/2754F8.s.o(.data);
        _275AB8_s = .;
        build/asm/275AB8.s.o(.data);
        _275BB8_s = .;
        build/asm/275BB8.s.o(.data);
        _2762F8_s = .;
        build/asm/2762F8.s.o(.data);
        _2763C8_s = .;
        build/asm/2763C8.s.o(.data);
        _276498_s = .;
        build/asm/276498.s.o(.data);
        _276828_s = .;
        build/asm/276828.s.o(.data);
        _276848_s = .;
        build/asm/276848.s.o(.data);
        _276D28_s = .;
        build/asm/276D28.s.o(.data);
        _277128_s = .;
        build/asm/277128.s.o(.data);
        _277668_s = .;
        build/asm/277668.s.o(.data);
        _278F78_s = .;
        build/asm/278F78.s.o(.data);
        _279028_s = .;
        build/asm/279028.s.o(.data);
        _286858_s = .;
        build/asm/286858.s.o(.data);
        _286A98_s = .;
        build/asm/286A98.s.o(.data);
        _287608_s = .;
        build/asm/287608.s.o(.data);
        _2876F8_s = .;
        build/asm/2876F8.s.o(.data);
        _287928_s = .;
        build/asm/287928.s.o(.data);
        _287E28_s = .;
        build/asm/287E28.s.o(.data);
        . += 0x64;
        . = ALIGN(., 16);
        main_DATA_END = .;
        main_DATA_SIZE = ABSOLUTE(main_DATA_END - main_DATA_START);
        main_RODATA_START = .;
        build/asm/main.s.o(.rodata);
        build/asm/000868.s.o(.rodata);
        build/asm/000D68.s.o(.rodata);
        build/asm/000DC8.s.o(.rodata);
        build/asm/0010F8.s.o(.rodata);
        build/asm/0011D8.s.o(.rodata);
        build/asm/001318.s.o(.rodata);
        build/asm/001408.s.o(.rodata);
        build/asm/0014B8.s.o(.rodata);
        build/asm/001538.s.o(.rodata);
        build/asm/001638.s.o(.rodata);
        build/asm/0016A8.s.o(.rodata);
        build/asm/001728.s.o(.rodata);
        build/asm/001A98.s.o(.rodata);
        build/asm/001BE8.s.o(.rodata);
        build/asm/001C38.s.o(.rodata);
        build/asm/002098.s.o(.rodata);
        build/asm/002268.s.o(.rodata);
        build/asm/002548.s.o(.rodata);
        build/asm/002848.s.o(.rodata);
        build/asm/002868.s.o(.rodata);
        build/asm/0028F8.s.o(.rodata);
        build/asm/0035E8.s.o(.rodata);
        build/asm/003668.s.o(.rodata);
        build/asm/003918.s.o(.rodata);
        build/asm/003998.s.o(.rodata);
        build/asm/003A58.s.o(.rodata);
        build/asm/003AD8.s.o(.rodata);
        build/asm/003F68.s.o(.rodata);
        build/asm/003FE8.s.o(.rodata);
        build/asm/0041B8.s.o(.rodata);
        build/asm/004238.s.o(.rodata);
        build/asm/0042C8.s.o(.rodata);
        build/asm/004358.s.o(.rodata);
        build/asm/0043A8.s.o(.rodata);
        build/asm/0045E8.s.o(.rodata);
        build/asm/004A18.s.o(.rodata);
        build/asm/0052C8.s.o(.rodata);
        build/asm/0052D8.s.o(.rodata);
        build/asm/0055D8.s.o(.rodata);
        build/asm/005808.s.o(.rodata);
        build/asm/005848.s.o(.rodata);
        build/asm/005888.s.o(.rodata);
        build/asm/005C48.s.o(.rodata);
        build/asm/006108.s.o(.rodata);
        build/asm/006218.s.o(.rodata);
        build/asm/0063E8.s.o(.rodata);
        build/asm/0066B8.s.o(.rodata);
        build/asm/006C68.s.o(.rodata);
        build/asm/007158.s.o(.rodata);
        build/asm/0073A8.s.o(.rodata);
        build/asm/007438.s.o(.rodata);
        build/asm/0076F8.s.o(.rodata);
        build/asm/007878.s.o(.rodata);
        build/asm/008348.s.o(.rodata);
        build/asm/008528.s.o(.rodata);
        build/asm/0093D8.s.o(.rodata);
        build/asm/0095E8.s.o(.rodata);
        build/asm/00A438.s.o(.rodata);
        build/asm/00A6F8.s.o(.rodata);
        build/asm/00A778.s.o(.rodata);
        build/asm/00A908.s.o(.rodata);
        build/asm/00B178.s.o(.rodata);
        build/asm/00B1B8.s.o(.rodata);
        build/asm/00B3F8.s.o(.rodata);
        build/asm/00B4D8.s.o(.rodata);
        build/asm/00C0B8.s.o(.rodata);
        build/asm/00C128.s.o(.rodata);
        build/asm/00C1F8.s.o(.rodata);
        build/asm/00C2F8.s.o(.rodata);
        build/asm/00CAB8.s.o(.rodata);
        build/asm/00CEC8.s.o(.rodata);
        build/asm/00D418.s.o(.rodata);
        build/asm/00D4C8.s.o(.rodata);
        build/asm/00D578.s.o(.rodata);
        build/asm/00D5C8.s.o(.rodata);
        build/asm/00D848.s.o(.rodata);
        build/asm/00D8B8.s.o(.rodata);
        build/asm/00D908.s.o(.rodata);
        build/asm/00DC28.s.o(.rodata);
        build/asm/00DC78.s.o(.rodata);
        build/asm/00DCD8.s.o(.rodata);
        build/asm/00DE08.s.o(.rodata);
        build/asm/00E808.s.o(.rodata);
        build/asm/00EB98.s.o(.rodata);
        build/asm/00EBB8.s.o(.rodata);
        build/asm/00FF08.s.o(.rodata);
        build/asm/00FF58.s.o(.rodata);
        build/asm/00FF98.s.o(.rodata);
        build/asm/010058.s.o(.rodata);
        build/asm/0109E8.s.o(.rodata);
        build/asm/010BA8.s.o(.rodata);
        build/asm/010C38.s.o(.rodata);
        build/asm/010E48.s.o(.rodata);
        build/asm/010F68.s.o(.rodata);
        build/asm/011028.s.o(.rodata);
        build/asm/0111F8.s.o(.rodata);
        build/asm/011358.s.o(.rodata);
        build/asm/011428.s.o(.rodata);
        build/asm/011538.s.o(.rodata);
        build/asm/0129D8.s.o(.rodata);
        build/asm/013028.s.o(.rodata);
        build/asm/013108.s.o(.rodata);
        build/asm/015A38.s.o(.rodata);
        build/asm/015C38.s.o(.rodata);
        build/asm/015C88.s.o(.rodata);
        build/asm/015E68.s.o(.rodata);
        build/asm/252E78.s.o(.rodata);
        build/asm/252EC8.s.o(.rodata);
        build/asm/252F18.s.o(.rodata);
        build/asm/253048.s.o(.rodata);
        build/asm/2534D8.s.o(.rodata);
        build/asm/253648.s.o(.rodata);
        build/asm/253818.s.o(.rodata);
        build/asm/253C68.s.o(.rodata);
        build/asm/254CA8.s.o(.rodata);
        build/asm/254CC8.s.o(.rodata);
        build/asm/254CE8.s.o(.rodata);
        build/asm/254F68.s.o(.rodata);
        build/asm/2555C8.s.o(.rodata);
        build/asm/2555D8.s.o(.rodata);
        build/asm/2555E8.s.o(.rodata);
        build/asm/2556E8.s.o(.rodata);
        build/asm/255808.s.o(.rodata);
        build/asm/255AE8.s.o(.rodata);
        build/asm/255B98.s.o(.rodata);
        build/asm/2564C8.s.o(.rodata);
        build/asm/256998.s.o(.rodata);
        build/asm/256D38.s.o(.rodata);
        build/asm/256DB8.s.o(.rodata);
        build/asm/257058.s.o(.rodata);
        build/asm/257388.s.o(.rodata);
        build/asm/257898.s.o(.rodata);
        build/asm/2578A8.s.o(.rodata);
        build/asm/258178.s.o(.rodata);
        build/asm/2589E8.s.o(.rodata);
        build/asm/258C08.s.o(.rodata);
        build/asm/258E68.s.o(.rodata);
        build/asm/258E98.s.o(.rodata);
        build/asm/259068.s.o(.rodata);
        build/asm/259AF8.s.o(.rodata);
        build/asm/259EC8.s.o(.rodata);
        build/asm/25A058.s.o(.rodata);
        build/asm/25A098.s.o(.rodata);
        build/asm/25A188.s.o(.rodata);
        build/asm/25A5A8.s.o(.rodata);
        build/asm/25A828.s.o(.rodata);
        build/asm/25A898.s.o(.rodata);
        build/asm/25A968.s.o(.rodata);
        build/asm/25ABF8.s.o(.rodata);
        build/asm/25AC18.s.o(.rodata);
        build/asm/25AF78.s.o(.rodata);
        build/asm/25B6C8.s.o(.rodata);
        build/asm/25B7E8.s.o(.rodata);
        build/asm/25BC28.s.o(.rodata);
        build/asm/25BC58.s.o(.rodata);
        build/asm/25BC88.s.o(.rodata);
        build/asm/25BD08.s.o(.rodata);
        build/asm/25BF68.s.o(.rodata);
        build/asm/25C038.s.o(.rodata);
        build/asm/25C108.s.o(.rodata);
        build/asm/25C1D8.s.o(.rodata);
        build/asm/25C2A8.s.o(.rodata);
        build/asm/25C378.s.o(.rodata);
        build/asm/25C448.s.o(.rodata);
        build/asm/25C478.s.o(.rodata);
        build/asm/25C488.s.o(.rodata);
        build/asm/25C5C8.s.o(.rodata);
        build/asm/25C6E8.s.o(.rodata);
        build/asm/25C748.s.o(.rodata);
        build/asm/25C808.s.o(.rodata);
        build/asm/25C888.s.o(.rodata);
        build/asm/25CB68.s.o(.rodata);
        build/asm/25CC78.s.o(.rodata);
        build/asm/25CCC8.s.o(.rodata);
        build/asm/25CCF8.s.o(.rodata);
        build/asm/25CD28.s.o(.rodata);
        build/asm/25CDC8.s.o(.rodata);
        build/asm/25CDF8.s.o(.rodata);
        build/asm/25CE28.s.o(.rodata);
        build/asm/25CEA8.s.o(.rodata);
        build/asm/25CED8.s.o(.rodata);
        build/asm/25CF08.s.o(.rodata);
        build/asm/25CF38.s.o(.rodata);
        build/asm/25CF68.s.o(.rodata);
        build/asm/25CF98.s.o(.rodata);
        build/asm/25CFC8.s.o(.rodata);
        build/asm/25D018.s.o(.rodata);
        build/asm/25D068.s.o(.rodata);
        build/asm/25D0C8.s.o(.rodata);
        build/asm/25D368.s.o(.rodata);
        build/asm/25D398.s.o(.rodata);
        build/asm/25D3C8.s.o(.rodata);
        build/asm/25DAC8.s.o(.rodata);
        build/asm/25DEC8.s.o(.rodata);
        build/asm/25DED8.s.o(.rodata);
        build/asm/25DEE8.s.o(.rodata);
        build/asm/25E158.s.o(.rodata);
        build/asm/25E218.s.o(.rodata);
        build/asm/25E238.s.o(.rodata);
        build/asm/25E268.s.o(.rodata);
        build/asm/25E568.s.o(.rodata);
        build/asm/25E638.s.o(.rodata);
        build/asm/25E808.s.o(.rodata);
        build/asm/25EF58.s.o(.rodata);
        build/asm/25EF68.s.o(.rodata);
        build/asm/25F328.s.o(.rodata);
        build/asm/25F3A8.s.o(.rodata);
        build/asm/25F3D8.s.o(.rodata);
        build/asm/25F548.s.o(.rodata);
        build/asm/25F9C8.s.o(.rodata);
        build/asm/25FCE8.s.o(.rodata);
        build/asm/25FDD8.s.o(.rodata);
        build/asm/25FF28.s.o(.rodata);
        build/asm/2602D8.s.o(.rodata);
        build/asm/2605E8.s.o(.rodata);
        build/asm/260688.s.o(.rodata);
        build/asm/2606D8.s.o(.rodata);
        build/asm/260728.s.o(.rodata);
        build/asm/260778.s.o(.rodata);
        build/asm/2607C8.s.o(.rodata);
        build/asm/260918.s.o(.rodata);
        build/asm/260A48.s.o(.rodata);
        build/asm/260B08.s.o(.rodata);
        build/asm/260CE8.s.o(.rodata);
        build/asm/260D58.s.o(.rodata);
        build/asm/261158.s.o(.rodata);
        build/asm/2611E8.s.o(.rodata);
        build/asm/2615E8.s.o(.rodata);
        build/asm/261648.s.o(.rodata);
        build/asm/2617E8.s.o(.rodata);
        build/asm/261D28.s.o(.rodata);
        build/asm/2621D8.s.o(.rodata);
        build/asm/262728.s.o(.rodata);
        build/asm/2627E8.s.o(.rodata);
        build/asm/262AE8.s.o(.rodata);
        build/asm/262D38.s.o(.rodata);
        build/asm/262F18.s.o(.rodata);
        build/asm/262F88.s.o(.rodata);
        build/asm/262FD8.s.o(.rodata);
        build/asm/2630A8.s.o(.rodata);
        build/asm/2630F8.s.o(.rodata);
        build/asm/263188.s.o(.rodata);
        build/asm/263248.s.o(.rodata);
        build/asm/263398.s.o(.rodata);
        build/asm/263428.s.o(.rodata);
        build/asm/263518.s.o(.rodata);
        build/asm/263788.s.o(.rodata);
        build/asm/263958.s.o(.rodata);
        build/asm/263CE8.s.o(.rodata);
        build/asm/263CF8.s.o(.rodata);
        build/asm/263EA8.s.o(.rodata);
        build/asm/264178.s.o(.rodata);
        build/asm/264578.s.o(.rodata);
        build/asm/264638.s.o(.rodata);
        build/asm/2646F8.s.o(.rodata);
        build/asm/264988.s.o(.rodata);
        build/asm/264CA8.s.o(.rodata);
        build/asm/264D38.s.o(.rodata);
        build/asm/265418.s.o(.rodata);
        build/asm/265538.s.o(.rodata);
        build/asm/265868.s.o(.rodata);
        build/asm/265BF8.s.o(.rodata);
        build/asm/265F98.s.o(.rodata);
        build/asm/265FA8.s.o(.rodata);
        build/asm/266098.s.o(.rodata);
        build/asm/2660A8.s.o(.rodata);
        build/asm/2660B8.s.o(.rodata);
        build/asm/266508.s.o(.rodata);
        build/asm/266518.s.o(.rodata);
        build/asm/266588.s.o(.rodata);
        build/asm/2667A8.s.o(.rodata);
        build/asm/266878.s.o(.rodata);
        build/asm/266BF8.s.o(.rodata);
        build/asm/267188.s.o(.rodata);
        build/asm/267C58.s.o(.rodata);
        build/asm/267C78.s.o(.rodata);
        build/asm/2683A8.s.o(.rodata);
        build/asm/268518.s.o(.rodata);
        build/asm/2685A8.s.o(.rodata);
        build/asm/2687D8.s.o(.rodata);
        build/asm/268B38.s.o(.rodata);
        build/asm/268C28.s.o(.rodata);
        build/asm/268CD8.s.o(.rodata);
        build/asm/268E88.s.o(.rodata);
        build/asm/269018.s.o(.rodata);
        build/asm/269128.s.o(.rodata);
        build/asm/269158.s.o(.rodata);
        build/asm/269188.s.o(.rodata);
        build/asm/2692D8.s.o(.rodata);
        build/asm/269558.s.o(.rodata);
        build/asm/269A68.s.o(.rodata);
        build/asm/269E78.s.o(.rodata);
        build/asm/269E98.s.o(.rodata);
        build/asm/269EC8.s.o(.rodata);
        build/asm/26A2C8.s.o(.rodata);
        build/asm/26A468.s.o(.rodata);
        build/asm/26A7B8.s.o(.rodata);
        build/asm/26AD38.s.o(.rodata);
        build/asm/26AD48.s.o(.rodata);
        build/asm/26AD58.s.o(.rodata);
        build/asm/26AD68.s.o(.rodata);
        build/asm/26AD78.s.o(.rodata);
        build/asm/26B228.s.o(.rodata);
        build/asm/26B268.s.o(.rodata);
        build/asm/26B4E8.s.o(.rodata);
        build/asm/26B5E8.s.o(.rodata);
        build/asm/26B6F8.s.o(.rodata);
        build/asm/26BCC8.s.o(.rodata);
        build/asm/26BD38.s.o(.rodata);
        build/asm/26BD98.s.o(.rodata);
        build/asm/26BDD8.s.o(.rodata);
        build/asm/26BE08.s.o(.rodata);
        build/asm/26BF98.s.o(.rodata);
        build/asm/26BFB8.s.o(.rodata);
        build/asm/26BFE8.s.o(.rodata);
        build/asm/26C258.s.o(.rodata);
        build/asm/26C3F8.s.o(.rodata);
        build/asm/26C448.s.o(.rodata);
        build/asm/26C538.s.o(.rodata);
        build/asm/26C6F8.s.o(.rodata);
        build/asm/26C978.s.o(.rodata);
        build/asm/26CDC8.s.o(.rodata);
        build/asm/26D3E8.s.o(.rodata);
        build/asm/26D458.s.o(.rodata);
        build/asm/26D4D8.s.o(.rodata);
        build/asm/26D558.s.o(.rodata);
        build/asm/26D608.s.o(.rodata);
        build/asm/26DB38.s.o(.rodata);
        build/asm/26DB58.s.o(.rodata);
        build/asm/26DFA8.s.o(.rodata);
        build/asm/26E008.s.o(.rodata);
        build/asm/26E0F8.s.o(.rodata);
        build/asm/26E128.s.o(.rodata);
        build/asm/26E138.s.o(.rodata);
        build/asm/26E148.s.o(.rodata);
        build/asm/26E1B8.s.o(.rodata);
        build/asm/26E3A8.s.o(.rodata);
        build/asm/26E6F8.s.o(.rodata);
        build/asm/26E728.s.o(.rodata);
        build/asm/26E7D8.s.o(.rodata);
        build/asm/26E9B8.s.o(.rodata);
        build/asm/26EB28.s.o(.rodata);
        build/asm/26F0D8.s.o(.rodata);
        build/asm/26F128.s.o(.rodata);
        build/asm/26F1B8.s.o(.rodata);
        build/asm/26F368.s.o(.rodata);
        build/asm/26F608.s.o(.rodata);
        build/asm/26F698.s.o(.rodata);
        build/asm/26F6D8.s.o(.rodata);
        build/asm/26F808.s.o(.rodata);
        build/asm/26F8B8.s.o(.rodata);
        build/asm/26F918.s.o(.rodata);
        build/asm/26FA78.s.o(.rodata);
        build/asm/26FE48.s.o(.rodata);
        build/asm/26FEE8.s.o(.rodata);
        build/asm/270898.s.o(.rodata);
        build/asm/270B88.s.o(.rodata);
        build/asm/270C48.s.o(.rodata);
        build/asm/270D38.s.o(.rodata);
        build/asm/270E18.s.o(.rodata);
        build/asm/271128.s.o(.rodata);
        build/asm/271F08.s.o(.rodata);
        build/asm/272248.s.o(.rodata);
        build/asm/273688.s.o(.rodata);
        build/asm/2736E8.s.o(.rodata);
        build/asm/273878.s.o(.rodata);
        build/asm/273898.s.o(.rodata);
        build/asm/273928.s.o(.rodata);
        build/asm/274268.s.o(.rodata);
        build/asm/2742F8.s.o(.rodata);
        build/asm/274308.s.o(.rodata);
        build/asm/274508.s.o(.rodata);
        build/asm/2750D8.s.o(.rodata);
        build/asm/2754C8.s.o(.rodata);
        build/asm/2754F8.s.o(.rodata);
        build/asm/275AB8.s.o(.rodata);
        build/asm/275BB8.s.o(.rodata);
        build/asm/2762F8.s.o(.rodata);
        build/asm/2763C8.s.o(.rodata);
        build/asm/276498.s.o(.rodata);
        build/asm/276828.s.o(.rodata);
        build/asm/276848.s.o(.rodata);
        build/asm/276D28.s.o(.rodata);
        build/asm/277128.s.o(.rodata);
        build/asm/277668.s.o(.rodata);
        build/asm/278F78.s.o(.rodata);
        build/asm/279028.s.o(.rodata);
        build/asm/286858.s.o(.rodata);
        build/asm/286A98.s.o(.rodata);
        build/asm/287608.s.o(.rodata);
        build/asm/2876F8.s.o(.rodata);
        build/asm/287928.s.o(.rodata);
        build/asm/287E28.s.o(.rodata);
        build/asm/data/data.rodata.s.o(.rodata);
        . = ALIGN(., 16);
        main_RODATA_END = .;
        main_RODATA_SIZE = ABSOLUTE(main_RODATA_END - main_RODATA_START);
    }
    main_bss_VRAM = ADDR(.main_bss);
    .main_bss (NOLOAD) :
    {
        FILL(0x00000000);
        main_BSS_START = .;
        build/asm/main.s.o(.bss);
        build/asm/000868.s.o(.bss);
        build/asm/000D68.s.o(.bss);
        build/asm/000DC8.s.o(.bss);
        build/asm/0010F8.s.o(.bss);
        build/asm/0011D8.s.o(.bss);
        build/asm/001318.s.o(.bss);
        build/asm/001408.s.o(.bss);
        build/asm/0014B8.s.o(.bss);
        build/asm/001538.s.o(.bss);
        build/asm/001638.s.o(.bss);
        build/asm/0016A8.s.o(.bss);
        build/asm/001728.s.o(.bss);
        build/asm/001A98.s.o(.bss);
        build/asm/001BE8.s.o(.bss);
        build/asm/001C38.s.o(.bss);
        build/asm/002098.s.o(.bss);
        build/asm/002268.s.o(.bss);
        build/asm/002548.s.o(.bss);
        build/asm/002848.s.o(.bss);
        build/asm/002868.s.o(.bss);
        build/asm/0028F8.s.o(.bss);
        build/asm/0035E8.s.o(.bss);
        build/asm/003668.s.o(.bss);
        build/asm/003918.s.o(.bss);
        build/asm/003998.s.o(.bss);
        build/asm/003A58.s.o(.bss);
        build/asm/003AD8.s.o(.bss);
        build/asm/003F68.s.o(.bss);
        build/asm/003FE8.s.o(.bss);
        build/asm/0041B8.s.o(.bss);
        build/asm/004238.s.o(.bss);
        build/asm/0042C8.s.o(.bss);
        build/asm/004358.s.o(.bss);
        build/asm/0043A8.s.o(.bss);
        build/asm/0045E8.s.o(.bss);
        build/asm/004A18.s.o(.bss);
        build/asm/0052C8.s.o(.bss);
        build/asm/0052D8.s.o(.bss);
        build/asm/0055D8.s.o(.bss);
        build/asm/005808.s.o(.bss);
        build/asm/005848.s.o(.bss);
        build/asm/005888.s.o(.bss);
        build/asm/005C48.s.o(.bss);
        build/asm/006108.s.o(.bss);
        build/asm/006218.s.o(.bss);
        build/asm/0063E8.s.o(.bss);
        build/asm/0066B8.s.o(.bss);
        build/asm/006C68.s.o(.bss);
        build/asm/007158.s.o(.bss);
        build/asm/0073A8.s.o(.bss);
        build/asm/007438.s.o(.bss);
        build/asm/0076F8.s.o(.bss);
        build/asm/007878.s.o(.bss);
        build/asm/008348.s.o(.bss);
        build/asm/008528.s.o(.bss);
        build/asm/0093D8.s.o(.bss);
        build/asm/0095E8.s.o(.bss);
        build/asm/00A438.s.o(.bss);
        build/asm/00A6F8.s.o(.bss);
        build/asm/00A778.s.o(.bss);
        build/asm/00A908.s.o(.bss);
        build/asm/00B178.s.o(.bss);
        build/asm/00B1B8.s.o(.bss);
        build/asm/00B3F8.s.o(.bss);
        build/asm/00B4D8.s.o(.bss);
        build/asm/00C0B8.s.o(.bss);
        build/asm/00C128.s.o(.bss);
        build/asm/00C1F8.s.o(.bss);
        build/asm/00C2F8.s.o(.bss);
        build/asm/00CAB8.s.o(.bss);
        build/asm/00CEC8.s.o(.bss);
        build/asm/00D418.s.o(.bss);
        build/asm/00D4C8.s.o(.bss);
        build/asm/00D578.s.o(.bss);
        build/asm/00D5C8.s.o(.bss);
        build/asm/00D848.s.o(.bss);
        build/asm/00D8B8.s.o(.bss);
        build/asm/00D908.s.o(.bss);
        build/asm/00DC28.s.o(.bss);
        build/asm/00DC78.s.o(.bss);
        build/asm/00DCD8.s.o(.bss);
        build/asm/00DE08.s.o(.bss);
        build/asm/00E808.s.o(.bss);
        build/asm/00EB98.s.o(.bss);
        build/asm/00EBB8.s.o(.bss);
        build/asm/00FF08.s.o(.bss);
        build/asm/00FF58.s.o(.bss);
        build/asm/00FF98.s.o(.bss);
        build/asm/010058.s.o(.bss);
        build/asm/0109E8.s.o(.bss);
        build/asm/010BA8.s.o(.bss);
        build/asm/010C38.s.o(.bss);
        build/asm/010E48.s.o(.bss);
        build/asm/010F68.s.o(.bss);
        build/asm/011028.s.o(.bss);
        build/asm/0111F8.s.o(.bss);
        build/asm/011358.s.o(.bss);
        build/asm/011428.s.o(.bss);
        build/asm/011538.s.o(.bss);
        build/asm/0129D8.s.o(.bss);
        build/asm/013028.s.o(.bss);
        build/asm/013108.s.o(.bss);
        build/asm/015A38.s.o(.bss);
        build/asm/015C38.s.o(.bss);
        build/asm/015C88.s.o(.bss);
        build/asm/015E68.s.o(.bss);
        build/asm/252E78.s.o(.bss);
        build/asm/252EC8.s.o(.bss);
        build/asm/252F18.s.o(.bss);
        build/asm/253048.s.o(.bss);
        build/asm/2534D8.s.o(.bss);
        build/asm/253648.s.o(.bss);
        build/asm/253818.s.o(.bss);
        build/asm/253C68.s.o(.bss);
        build/asm/254CA8.s.o(.bss);
        build/asm/254CC8.s.o(.bss);
        build/asm/254CE8.s.o(.bss);
        build/asm/254F68.s.o(.bss);
        build/asm/2555C8.s.o(.bss);
        build/asm/2555D8.s.o(.bss);
        build/asm/2555E8.s.o(.bss);
        build/asm/2556E8.s.o(.bss);
        build/asm/255808.s.o(.bss);
        build/asm/255AE8.s.o(.bss);
        build/asm/255B98.s.o(.bss);
        build/asm/2564C8.s.o(.bss);
        build/asm/256998.s.o(.bss);
        build/asm/256D38.s.o(.bss);
        build/asm/256DB8.s.o(.bss);
        build/asm/257058.s.o(.bss);
        build/asm/257388.s.o(.bss);
        build/asm/257898.s.o(.bss);
        build/asm/2578A8.s.o(.bss);
        build/asm/258178.s.o(.bss);
        build/asm/2589E8.s.o(.bss);
        build/asm/258C08.s.o(.bss);
        build/asm/258E68.s.o(.bss);
        build/asm/258E98.s.o(.bss);
        build/asm/259068.s.o(.bss);
        build/asm/259AF8.s.o(.bss);
        build/asm/259EC8.s.o(.bss);
        build/asm/25A058.s.o(.bss);
        build/asm/25A098.s.o(.bss);
        build/asm/25A188.s.o(.bss);
        build/asm/25A5A8.s.o(.bss);
        build/asm/25A828.s.o(.bss);
        build/asm/25A898.s.o(.bss);
        build/asm/25A968.s.o(.bss);
        build/asm/25ABF8.s.o(.bss);
        build/asm/25AC18.s.o(.bss);
        build/asm/25AF78.s.o(.bss);
        build/asm/25B6C8.s.o(.bss);
        build/asm/25B7E8.s.o(.bss);
        build/asm/25BC28.s.o(.bss);
        build/asm/25BC58.s.o(.bss);
        build/asm/25BC88.s.o(.bss);
        build/asm/25BD08.s.o(.bss);
        build/asm/25BF68.s.o(.bss);
        build/asm/25C038.s.o(.bss);
        build/asm/25C108.s.o(.bss);
        build/asm/25C1D8.s.o(.bss);
        build/asm/25C2A8.s.o(.bss);
        build/asm/25C378.s.o(.bss);
        build/asm/25C448.s.o(.bss);
        build/asm/25C478.s.o(.bss);
        build/asm/25C488.s.o(.bss);
        build/asm/25C5C8.s.o(.bss);
        build/asm/25C6E8.s.o(.bss);
        build/asm/25C748.s.o(.bss);
        build/asm/25C808.s.o(.bss);
        build/asm/25C888.s.o(.bss);
        build/asm/25CB68.s.o(.bss);
        build/asm/25CC78.s.o(.bss);
        build/asm/25CCC8.s.o(.bss);
        build/asm/25CCF8.s.o(.bss);
        build/asm/25CD28.s.o(.bss);
        build/asm/25CDC8.s.o(.bss);
        build/asm/25CDF8.s.o(.bss);
        build/asm/25CE28.s.o(.bss);
        build/asm/25CEA8.s.o(.bss);
        build/asm/25CED8.s.o(.bss);
        build/asm/25CF08.s.o(.bss);
        build/asm/25CF38.s.o(.bss);
        build/asm/25CF68.s.o(.bss);
        build/asm/25CF98.s.o(.bss);
        build/asm/25CFC8.s.o(.bss);
        build/asm/25D018.s.o(.bss);
        build/asm/25D068.s.o(.bss);
        build/asm/25D0C8.s.o(.bss);
        build/asm/25D368.s.o(.bss);
        build/asm/25D398.s.o(.bss);
        build/asm/25D3C8.s.o(.bss);
        build/asm/25DAC8.s.o(.bss);
        build/asm/25DEC8.s.o(.bss);
        build/asm/25DED8.s.o(.bss);
        build/asm/25DEE8.s.o(.bss);
        build/asm/25E158.s.o(.bss);
        build/asm/25E218.s.o(.bss);
        build/asm/25E238.s.o(.bss);
        build/asm/25E268.s.o(.bss);
        build/asm/25E568.s.o(.bss);
        build/asm/25E638.s.o(.bss);
        build/asm/25E808.s.o(.bss);
        build/asm/25EF58.s.o(.bss);
        build/asm/25EF68.s.o(.bss);
        build/asm/25F328.s.o(.bss);
        build/asm/25F3A8.s.o(.bss);
        build/asm/25F3D8.s.o(.bss);
        build/asm/25F548.s.o(.bss);
        build/asm/25F9C8.s.o(.bss);
        build/asm/25FCE8.s.o(.bss);
        build/asm/25FDD8.s.o(.bss);
        build/asm/25FF28.s.o(.bss);
        build/asm/2602D8.s.o(.bss);
        build/asm/2605E8.s.o(.bss);
        build/asm/260688.s.o(.bss);
        build/asm/2606D8.s.o(.bss);
        build/asm/260728.s.o(.bss);
        build/asm/260778.s.o(.bss);
        build/asm/2607C8.s.o(.bss);
        build/asm/260918.s.o(.bss);
        build/asm/260A48.s.o(.bss);
        build/asm/260B08.s.o(.bss);
        build/asm/260CE8.s.o(.bss);
        build/asm/260D58.s.o(.bss);
        build/asm/261158.s.o(.bss);
        build/asm/2611E8.s.o(.bss);
        build/asm/2615E8.s.o(.bss);
        build/asm/261648.s.o(.bss);
        build/asm/2617E8.s.o(.bss);
        build/asm/261D28.s.o(.bss);
        build/asm/2621D8.s.o(.bss);
        build/asm/262728.s.o(.bss);
        build/asm/2627E8.s.o(.bss);
        build/asm/262AE8.s.o(.bss);
        build/asm/262D38.s.o(.bss);
        build/asm/262F18.s.o(.bss);
        build/asm/262F88.s.o(.bss);
        build/asm/262FD8.s.o(.bss);
        build/asm/2630A8.s.o(.bss);
        build/asm/2630F8.s.o(.bss);
        build/asm/263188.s.o(.bss);
        build/asm/263248.s.o(.bss);
        build/asm/263398.s.o(.bss);
        build/asm/263428.s.o(.bss);
        build/asm/263518.s.o(.bss);
        build/asm/263788.s.o(.bss);
        build/asm/263958.s.o(.bss);
        build/asm/263CE8.s.o(.bss);
        build/asm/263CF8.s.o(.bss);
        build/asm/263EA8.s.o(.bss);
        build/asm/264178.s.o(.bss);
        build/asm/264578.s.o(.bss);
        build/asm/264638.s.o(.bss);
        build/asm/2646F8.s.o(.bss);
        build/asm/264988.s.o(.bss);
        build/asm/264CA8.s.o(.bss);
        build/asm/264D38.s.o(.bss);
        build/asm/265418.s.o(.bss);
        build/asm/265538.s.o(.bss);
        build/asm/265868.s.o(.bss);
        build/asm/265BF8.s.o(.bss);
        build/asm/265F98.s.o(.bss);
        build/asm/265FA8.s.o(.bss);
        build/asm/266098.s.o(.bss);
        build/asm/2660A8.s.o(.bss);
        build/asm/2660B8.s.o(.bss);
        build/asm/266508.s.o(.bss);
        build/asm/266518.s.o(.bss);
        build/asm/266588.s.o(.bss);
        build/asm/2667A8.s.o(.bss);
        build/asm/266878.s.o(.bss);
        build/asm/266BF8.s.o(.bss);
        build/asm/267188.s.o(.bss);
        build/asm/267C58.s.o(.bss);
        build/asm/267C78.s.o(.bss);
        build/asm/2683A8.s.o(.bss);
        build/asm/268518.s.o(.bss);
        build/asm/2685A8.s.o(.bss);
        build/asm/2687D8.s.o(.bss);
        build/asm/268B38.s.o(.bss);
        build/asm/268C28.s.o(.bss);
        build/asm/268CD8.s.o(.bss);
        build/asm/268E88.s.o(.bss);
        build/asm/269018.s.o(.bss);
        build/asm/269128.s.o(.bss);
        build/asm/269158.s.o(.bss);
        build/asm/269188.s.o(.bss);
        build/asm/2692D8.s.o(.bss);
        build/asm/269558.s.o(.bss);
        build/asm/269A68.s.o(.bss);
        build/asm/269E78.s.o(.bss);
        build/asm/269E98.s.o(.bss);
        build/asm/269EC8.s.o(.bss);
        build/asm/26A2C8.s.o(.bss);
        build/asm/26A468.s.o(.bss);
        build/asm/26A7B8.s.o(.bss);
        build/asm/26AD38.s.o(.bss);
        build/asm/26AD48.s.o(.bss);
        build/asm/26AD58.s.o(.bss);
        build/asm/26AD68.s.o(.bss);
        build/asm/26AD78.s.o(.bss);
        build/asm/26B228.s.o(.bss);
        build/asm/26B268.s.o(.bss);
        build/asm/26B4E8.s.o(.bss);
        build/asm/26B5E8.s.o(.bss);
        build/asm/26B6F8.s.o(.bss);
        build/asm/26BCC8.s.o(.bss);
        build/asm/26BD38.s.o(.bss);
        build/asm/26BD98.s.o(.bss);
        build/asm/26BDD8.s.o(.bss);
        build/asm/26BE08.s.o(.bss);
        build/asm/26BF98.s.o(.bss);
        build/asm/26BFB8.s.o(.bss);
        build/asm/26BFE8.s.o(.bss);
        build/asm/26C258.s.o(.bss);
        build/asm/26C3F8.s.o(.bss);
        build/asm/26C448.s.o(.bss);
        build/asm/26C538.s.o(.bss);
        build/asm/26C6F8.s.o(.bss);
        build/asm/26C978.s.o(.bss);
        build/asm/26CDC8.s.o(.bss);
        build/asm/26D3E8.s.o(.bss);
        build/asm/26D458.s.o(.bss);
        build/asm/26D4D8.s.o(.bss);
        build/asm/26D558.s.o(.bss);
        build/asm/26D608.s.o(.bss);
        build/asm/26DB38.s.o(.bss);
        build/asm/26DB58.s.o(.bss);
        build/asm/26DFA8.s.o(.bss);
        build/asm/26E008.s.o(.bss);
        build/asm/26E0F8.s.o(.bss);
        build/asm/26E128.s.o(.bss);
        build/asm/26E138.s.o(.bss);
        build/asm/26E148.s.o(.bss);
        build/asm/26E1B8.s.o(.bss);
        build/asm/26E3A8.s.o(.bss);
        build/asm/26E6F8.s.o(.bss);
        build/asm/26E728.s.o(.bss);
        build/asm/26E7D8.s.o(.bss);
        build/asm/26E9B8.s.o(.bss);
        build/asm/26EB28.s.o(.bss);
        build/asm/26F0D8.s.o(.bss);
        build/asm/26F128.s.o(.bss);
        build/asm/26F1B8.s.o(.bss);
        build/asm/26F368.s.o(.bss);
        build/asm/26F608.s.o(.bss);
        build/asm/26F698.s.o(.bss);
        build/asm/26F6D8.s.o(.bss);
        build/asm/26F808.s.o(.bss);
        build/asm/26F8B8.s.o(.bss);
        build/asm/26F918.s.o(.bss);
        build/asm/26FA78.s.o(.bss);
        build/asm/26FE48.s.o(.bss);
        build/asm/26FEE8.s.o(.bss);
        build/asm/270898.s.o(.bss);
        build/asm/270B88.s.o(.bss);
        build/asm/270C48.s.o(.bss);
        build/asm/270D38.s.o(.bss);
        build/asm/270E18.s.o(.bss);
        build/asm/271128.s.o(.bss);
        build/asm/271F08.s.o(.bss);
        build/asm/272248.s.o(.bss);
        build/asm/273688.s.o(.bss);
        build/asm/2736E8.s.o(.bss);
        build/asm/273878.s.o(.bss);
        build/asm/273898.s.o(.bss);
        build/asm/273928.s.o(.bss);
        build/asm/274268.s.o(.bss);
        build/asm/2742F8.s.o(.bss);
        build/asm/274308.s.o(.bss);
        build/asm/274508.s.o(.bss);
        build/asm/2750D8.s.o(.bss);
        build/asm/2754C8.s.o(.bss);
        build/asm/2754F8.s.o(.bss);
        build/asm/275AB8.s.o(.bss);
        build/asm/275BB8.s.o(.bss);
        build/asm/2762F8.s.o(.bss);
        build/asm/2763C8.s.o(.bss);
        build/asm/276498.s.o(.bss);
        build/asm/276828.s.o(.bss);
        build/asm/276848.s.o(.bss);
        build/asm/276D28.s.o(.bss);
        build/asm/277128.s.o(.bss);
        build/asm/277668.s.o(.bss);
        build/asm/278F78.s.o(.bss);
        build/asm/279028.s.o(.bss);
        build/asm/286858.s.o(.bss);
        build/asm/286A98.s.o(.bss);
        build/asm/287608.s.o(.bss);
        build/asm/2876F8.s.o(.bss);
        build/asm/287928.s.o(.bss);
        build/asm/287E28.s.o(.bss);
        . = ALIGN(., 16);
        main_BSS_END = .;
        main_BSS_SIZE = ABSOLUTE(main_BSS_END - main_BSS_START);
    }
    __romPos += SIZEOF(.main);
    __romPos = ALIGN(__romPos, 16);
    . = ALIGN(., 16);
    main_ROM_END = __romPos;
    main_VRAM_END = .;

    comment_ROM_START = __romPos;
    comment_VRAM = ADDR(.comment);
    .comment : AT(comment_ROM_START)
    {
        FILL(0x00000000);
        comment_TEXT_START = .;
        build/asm/data/comment.s.o(.text);
        comment_TEXT_END = .;
        comment_TEXT_SIZE = ABSOLUTE(comment_TEXT_END - comment_TEXT_START);
    }
    __romPos += SIZEOF(.comment);
    comment_ROM_END = __romPos;
    comment_VRAM_END = .;

    reginfo_ROM_START = __romPos;
    reginfo_VRAM = ADDR(.reginfo);
    .reginfo : AT(reginfo_ROM_START)
    {
        FILL(0x00000000);
        reginfo_TEXT_START = .;
        build/asm/data/reginfo.s.o(.text);
        reginfo_TEXT_END = .;
        reginfo_TEXT_SIZE = ABSOLUTE(reginfo_TEXT_END - reginfo_TEXT_START);
    }
    __romPos += SIZEOF(.reginfo);
    reginfo_ROM_END = __romPos;
    reginfo_VRAM_END = .;

    /DISCARD/ :
    {
        *(*);
    }
}
